## firmware/02_UART/stm32f407-fw/boards/baram/stm32f407_kit/Kconfig.stm32f407_kit
```kconfig
# Copyright (c) 2016 Linaro Limited.
# SPDX-License-Identifier: Apache-2.0

config BOARD_STM32F407_KIT
	select SOC_STM32F407XG
```

## firmware/02_UART/stm32f407-fw/boards/baram/stm32f407_kit/board.yml
```yaml
board:
  name: stm32f407_kit
  full_name: STM32F407 KIT
  vendor: baram
  socs:
    - name: stm32f407xx
```

## firmware/04_OLED/stm32f407-oled/boards/baram/stm32f407_kit/Kconfig.stm32f407_kit
```kconfig
# Copyright (c) 2016 Linaro Limited.
# SPDX-License-Identifier: Apache-2.0

config BOARD_STM32F407_KIT
	select SOC_STM32F407XG

  select USE_STM32_HAL_GPIO
  select USE_STM32_HAL_I2C
  select USE_STM32_HAL_I2C_EX
```

## firmware/07_FAT/stm32f407-fat/boards/baram/stm32f407_kit/Kconfig.defconfig
```kconfig
# Copyright (c) 2025 TOKITA Hiroshi
# SPDX-License-Identifier: Apache-2.0

if BOARD_STM32F407_KIT

if NETWORKING

config NET_L2_ETHERNET
	default y
config MDIO
	default y
config TEST_RANDOM_GENERATOR
	default y

endif # NETWORKING

endif 
```
